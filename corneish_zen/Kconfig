## corneish_zen/west.yml
```yaml
manifest:
  remotes:
    - name: zmkfirmware
      url-base: https://github.com/zmkfirmware
    - name: urob
      url-base: https://github.com/urob
  projects:
    - name: zmk
      remote: urob
      revision: main
      import: app/west.yml
    - name: zmk-nodefree-config
      remote: urob
      revision: main
      path: corneish_zen/zmk-nodefree-config
  self:
    path: corneish_zen
```
