/*
 *
 * Copyright (c) 2021 Darryl deHaan
 * SPDX-License-Identifier: MIT
 *
 */

#include <behaviors.dtsi>
#include <dt-bindings/zmk/keys.h>
#include <dt-bindings/zmk/bt.h>

#include "../zmk-nodefree-config/helper.h"
#include "../zmk-nodefree-config/keypos_def/keypos_42keys.h"
#include "keymap_swedish.h"
#include "homerow_mods.h"
#include "corneish_zen.h"

#include "mouse.dtsi"

/ {
    chosen {
        // clang-format off
    zmk,matrix_transform = &default_transform;
        // clang-format on
    };
};

// clang-format off
&caps_word { continue-list = <SE_UNDS SE_MINS BACKSPACE>; };
// clang-format on

/ {
    conditional_layers {
        compatible = "zmk,conditional-layers";
        tri_layer {
            // clang-format off
            if-layers = <LOWER RAISE>;
            then-layer = <ADJUST>;
            // clang-format on
        };
    };
};

/* Global settings */

#define QUICK_TAP_MS 175

&sk {  // sticky-key config
    release-after-ms = <900>;  // release after 0.6s
    quick-release;             // no double capitalization when rolling keys
};

&sl {  // sticky-layer config
    ignore-modifiers;          // allow chording sticky mods & layers
};

// smart-mouse, requires PR #1366
ZMK_BEHAVIOR(smart_mouse, tri_state,
    bindings = <&tog MOUSE>, <&none>, <&tog MOUSE>;
    ignored-key-positions = <LT1 LT3 RT1 RT2 RT3 RM1 RM2 RM3 RH0 RH1>;
    ignored-layers = <MOUSE>;
)

/ {
    combos{
#include "combos.dtsi"
    };

    macros{
#include "macros.dtsi"
    };

    keymap {
        compatible = "zmk,keymap";

        default_layer {
            label = "QWERTY";
            bindings = <
                // clang-format off
//╭─────────────┬─────────────┬─────────────┬─────────────┬─────────────┬─────────────╮  ╭─────────────┬─────────────┬─────────────┬─────────────┬─────────────┬─────────────╮
    TABFNC        &kp Q         &kp W         &kp E         &kp R         &kp T            &kp Y         &kp U         &kp I         &kp O         &kp P         &kp SE_ARNG
//├─────────────┼─────────────┼─────────────┼─────────────┼─────────────┼─────────────┤  ├─────────────┼─────────────┼─────────────┼─────────────┼─────────────┼─────────────┤
    C_ESC         HRM_A         HRM_S         HRM_D         HRM_F         &kp G            &kp H         HRM_J         HRM_K         HRM_L         HRM_OE        &kp SE_ADIA
//├─────────────┼─────────────┼─────────────┼─────────────┼─────────────┼─────────────┤  ├─────────────┼─────────────┼─────────────┼─────────────┼─────────────┼─────────────┤
    SLWM          &kp Z         &kp X         &kp C         &kp V         &kp B            &kp N         &kp M         &kp SE_COMM   &kp SE_DOT    &kp SE_MINS   &smart_mouse
//╰─────────────┴─────────────┴─────────────┴─────────────┼─────────────┼─────────────┤  ├─────────────┼─────────────┼─────────────┼─────────────┴─────────────┴─────────────╯
                                              &mo NUM       BS_LOW        TABNUM           SPCNAV        ENT_RS        &kp MEH
//                                          ╰─────────────┴─────────────┴─────────────╯  ╰─────────────┴─────────────┴─────────────╯
                // clang-format on
                >;
        };

        game_layer {
            label = "GAME";
            bindings = <
                // clang-format off
//╭─────────────┬─────────────┬─────────────┬─────────────┬─────────────┬─────────────╮  ╭─────────────┬─────────────┬─────────────┬─────────────┬─────────────┬─────────────╮
    &kp TAB       &kp Q         &kp W         &kp E         &kp R         &kp T            &kp Y         &kp U         &kp I         &kp O         &kp P         &kp SE_ARNG
//├─────────────┼─────────────┼─────────────┼─────────────┼─────────────┼─────────────┤  ├─────────────┼─────────────┼─────────────┼─────────────┼─────────────┼─────────────┤
    C_ESC         &kp A         &kp S         &kp D         &kp F         &kp G            &kp H         &kp J         &kp K         &kp L         &kp SE_ODIA   &kp SE_ADIA
//├─────────────┼─────────────┼─────────────┼─────────────┼─────────────┼─────────────┤  ├─────────────┼─────────────┼─────────────┼─────────────┼─────────────┼─────────────┤
    &kp LSHFT     &kp Z         &kp X         &kp C         &kp V         &kp B            &kp N         &kp M         &kp SE_COMM   &kp SE_DOT    &kp SE_MINS   &kp ESC
//╰─────────────┴─────────────┴─────────────┴─────────────┼─────────────┼─────────────┤  ├─────────────┼─────────────┼─────────────┼─────────────┴─────────────┴─────────────╯
                                              &kp ESC       &kp LALT      SPC_GL           SPCNAV        ENT_RS        &to QWERTY
//                                          ╰─────────────┴─────────────┴─────────────╯  ╰─────────────┴─────────────┴─────────────╯
                // clang-format on
                >;
        };

        lower_layer {
            label = "LOWER";
            bindings = <
                // clang-format off
//╭─────────────┬─────────────┬─────────────┬─────────────┬─────────────┬─────────────╮  ╭─────────────┬─────────────┬─────────────┬─────────────┬─────────────┬─────────────╮
   &kp SE_AT      &kp SE_EXLM   &kp SE_DQUO   &kp SE_HASH   &kp SE_DLR    &kp SE_PERC      &kp SE_AMPR   &kp SE_SLSH   &kp SE_LPRN   &kp SE_RPRN   &kp SE_EQL    &kp SE_BSLS
//├─────────────┼─────────────┼─────────────┼─────────────┼─────────────┼─────────────┤  ├─────────────┼─────────────┼─────────────┼─────────────┼─────────────┼─────────────┤
   &kp SE_AT      &kp SE_EXLM   &kp SE_DQUO   &kp SE_HASH   &kp SE_DLR    &kp SE_PERC      &kp SE_AT     &kp SE_QUES   &kp SE_LBRC   &kp SE_RBRC   &kp SE_DLR    &kp SE_ASTR
//├─────────────┼─────────────┼─────────────┼─────────────┼─────────────┼─────────────┤  ├─────────────┼─────────────┼─────────────┼─────────────┼─────────────┼─────────────┤
   &kp LSHFT      XXX           &kp SE_PND    &kp SE_EURO   &kp SE_AT     &kp SE_CURR      XXX           &kp SE_ASTR   &kp SE_LCBR   &kp SE_RCBR   XXX           XXX
//╰─────────────┴─────────────┴─────────────┴─────────────┼─────────────┼─────────────┤  ├─────────────┼─────────────┼─────────────┼─────────────┴─────────────┴─────────────╯
                                              XXX           ___           XXX              ___           ___           XXX
//                                          ╰─────────────┴─────────────┴─────────────╯  ╰─────────────┴─────────────┴─────────────╯
                // clang-format on
                >;
        };

        raise_layer {
            label = "RAISE";
            bindings = <
                // clang-format off
//╭─────────────┬─────────────┬─────────────┬─────────────┬─────────────┬─────────────╮  ╭─────────────┬─────────────┬─────────────┬─────────────┬─────────────┬─────────────╮
    &kp SE_CIRC   &kp N1        &kp N2        &kp N3        &kp N4        &kp N5           &kp N6        &kp N7        &kp N8        &kp N9        &kp N0        &kp DEL
//├─────────────┼─────────────┼─────────────┼─────────────┼─────────────┼─────────────┤  ├─────────────┼─────────────┼─────────────┼─────────────┼─────────────┼─────────────┤
    &kp DEL       &kp SE_PIPE   &kp SE_TILD   &kp SE_LABK   &kp SE_RABK   XXX              &kp SE_QUOT   &kp SE_PLUS   &kp SE_GRV    &kp SE_ARNG   XXX           XXX
//├─────────────┼─────────────┼─────────────┼─────────────┼─────────────┼─────────────┤  ├─────────────┼─────────────┼─────────────┼─────────────┼─────────────┼─────────────┤
    &kp LSHFT     XXX           XXX           XXX           &kp SE_PIPE   XXX              XXX           &kp SE_ASTR   &kp SE_LCBR   &kp SE_RCBR   XXX           XXX
//╰─────────────┴─────────────┴─────────────┴─────────────┼─────────────┼─────────────┤  ├─────────────┼─────────────┼─────────────┼─────────────┴─────────────┴─────────────╯
                                              &kp LGUI      ___           &kp SPACE        XXX           ___           &kp RALT
//                                          ╰─────────────┴─────────────┴─────────────╯  ╰─────────────┴─────────────┴─────────────╯
                // clang-format on
                >;
        };

        game_low_layer {
            label = "GLow";
            bindings = <
                // clang-format off
//╭─────────────┬─────────────┬─────────────┬─────────────┬─────────────┬─────────────╮  ╭─────────────┬─────────────┬─────────────┬─────────────┬─────────────┬─────────────╮
    ___           &kp N8        &kp N7        &kp N6        &kp N5        ___              ___           ___           ___           ___           ___           ___
//├─────────────┼─────────────┼─────────────┼─────────────┼─────────────┼─────────────┤  ├─────────────┼─────────────┼─────────────┼─────────────┼─────────────┼─────────────┤
    ___           &kp N4        &kp N3        &kp N2        &kp N1        ___              ___           ___           ___           ___           ___           ___
//├─────────────┼─────────────┼─────────────┼─────────────┼─────────────┼─────────────┤  ├─────────────┼─────────────┼─────────────┼─────────────┼─────────────┼─────────────┤
    ___           ___           ___           ___           ___           &kp DEL          ___           ___           ___           ___           ___           ___
//╰─────────────┴─────────────┴─────────────┴─────────────┼─────────────┼─────────────┤  ├─────────────┼─────────────┼─────────────┼─────────────┴─────────────┴─────────────╯
                                              ___           ___           XXX              ___           ___           ___
//                                          ╰─────────────┴─────────────┴─────────────╯  ╰─────────────┴─────────────┴─────────────╯
                // clang-format on
                >;
        };

        nav_layer {
            label = "NAV";
            bindings = <
                // clang-format off
//╭─────────────┬─────────────┬─────────────┬─────────────┬─────────────┬─────────────╮  ╭─────────────┬─────────────┬─────────────┬─────────────┬─────────────┬─────────────╮
    XXX           XXX           &kp LGUI      &kp LALT      XXX           &kp PG_UP        YANK          TAB_PREV      XXX           TAB_NEXT      PASTE         XXX
//├─────────────┼─────────────┼─────────────┼─────────────┼─────────────┼─────────────┤  ├─────────────┼─────────────┼─────────────┼─────────────┼─────────────┼─────────────┤
    TOBASE        &kp HOME      &kp END       &kp LCTRL     &kp LSHFT     &kp PG_DN        &kp LEFT      &kp DOWN      &kp UP        &kp RIGHT     &kp DEL       XXX
//├─────────────┼─────────────┼─────────────┼─────────────┼─────────────┼─────────────┤  ├─────────────┼─────────────┼─────────────┼─────────────┼─────────────┼─────────────┤
    XXX           XXX           DLINE         COMNT         DUPLIC        XXX              CLeft         YANK          PASTE         CRight        XXX           &kp PSCRN
//╰─────────────┴─────────────┴─────────────┴─────────────┼─────────────┼─────────────┤  ├─────────────┼─────────────┼─────────────┼─────────────┴─────────────┴─────────────╯
                                              XXX           &kp BSPC      &kp TAB          TOBASE        &kp ENTER     XXX
//                                          ╰─────────────┴─────────────┴─────────────╯  ╰─────────────┴─────────────┴─────────────╯
                // clang-format on
                >;
        };

        window_layer {
            label = "WIN MAN";
            bindings = <
                // clang-format off
//╭─────────────┬─────────────┬─────────────┬─────────────┬─────────────┬─────────────╮  ╭─────────────┬─────────────┬─────────────┬─────────────┬─────────────┬─────────────╮
    XXX           CLOSE         XXX           XXX           XXX           XXX              XXX           &kp LG(N7)    &kp LG(N8)    &kp LG(N9)    XXX           XXX
//├─────────────┼─────────────┼─────────────┼─────────────┼─────────────┼─────────────┤  ├─────────────┼─────────────┼─────────────┼─────────────┼─────────────┼─────────────┤
    XXX           XXX           XXX           XXX           &sk LSHFT     XXX              XXX           &kp LG(N4)    &kp LG(N5)    &kp LG(N6)    XXX           XXX
//├─────────────┼─────────────┼─────────────┼─────────────┼─────────────┼─────────────┤  ├─────────────┼─────────────┼─────────────┼─────────────┼─────────────┼─────────────┤
    XXX           XXX           XXX           XXX           XXX           XXX              XXX           &kp LG(N1)    &kp LG(N2)    &kp LG(N3)    XXX           CAD
//╰─────────────┴─────────────┴─────────────┴─────────────┼─────────────┼─────────────┤  ├─────────────┼─────────────┼─────────────┼─────────────┴─────────────┴─────────────╯
                                              XXX           XXX           XXX              XXX           &kp LG(N0)    XXX
//                                          ╰─────────────┴─────────────┴─────────────╯  ╰─────────────┴─────────────┴─────────────╯
                // clang-format on
                >;
        };

        number_layer {
            label = "NUMBER";
            bindings = <
                // clang-format off
//╭─────────────┬─────────────┬─────────────┬─────────────┬─────────────┬─────────────╮  ╭─────────────┬─────────────┬─────────────┬─────────────┬─────────────┬─────────────╮
    &kp TAB       XXX           TAB_PREV      PREV          TAB_NEXT      &macro_td        &kp KP_DIVIDE &kp N7        &kp N8        &kp N9        &kp KP_MULTIPLY &kp BSPC
//├─────────────┼─────────────┼─────────────┼─────────────┼─────────────┼─────────────┤  ├─────────────┼─────────────┼─────────────┼─────────────┼─────────────┼─────────────┤
    XXX           XXX           KUT           YANK          PASTE         NEXT             &kp BSPC      &kp N4        &kp N5        &kp N6        &kp KP_MINUS  XXX
//├─────────────┼─────────────┼─────────────┼─────────────┼─────────────┼─────────────┤  ├─────────────┼─────────────┼─────────────┼─────────────┼─────────────┼─────────────┤
    XXX           XXX           XXX           XXX           XXX           XXX              XXX           &kp N1        &kp N2        &kp N3        &kp KP_PLUS   &caps_word
//╰─────────────┴─────────────┴─────────────┴─────────────┼─────────────┼─────────────┤  ├─────────────┼─────────────┼─────────────┼─────────────┴─────────────┴─────────────╯
                                              XXX           XXX           XXX              &kp TAB       &kp N0        &kp ENTER
//                                          ╰─────────────┴─────────────┴─────────────╯  ╰─────────────┴─────────────┴─────────────╯
                // clang-format on
                >;
        };

        function_layer {
            label = "FUNCTION";
            bindings = <
                // clang-format off
//╭─────────────┬─────────────┬─────────────┬─────────────┬─────────────┬─────────────╮  ╭─────────────┬─────────────┬─────────────┬─────────────┬─────────────┬─────────────╮
    XXX           XXX           XXX           XXX           XXX           XXX              &kp F10       &kp F7        &kp F8        &kp F9        XXX           XXX
//├─────────────┼─────────────┼─────────────┼─────────────┼─────────────┼─────────────┤  ├─────────────┼─────────────┼─────────────┼─────────────┼─────────────┼─────────────┤
    XXX           &kp LGUI      &kp LALT      &kp LCTRL     &kp LSHFT     XXX              &kp F11       &kp F4        &kp F5        &kp F6        XXX           XXX
//├─────────────┼─────────────┼─────────────┼─────────────┼─────────────┼─────────────┤  ├─────────────┼─────────────┼─────────────┼─────────────┼─────────────┼─────────────┤
    XXX           XXX           XXX           XXX           XXX           XXX              &kp F12       &kp F1        &kp F2        &kp F3        XXX           XXX
//╰─────────────┴─────────────┴─────────────┴─────────────┼─────────────┼─────────────┤  ├─────────────┼─────────────┼─────────────┼─────────────┴─────────────┴─────────────╯
                                              XXX           XXX           XXX              XXX           XXX           XXX
//                                          ╰─────────────┴─────────────┴─────────────╯  ╰─────────────┴─────────────┴─────────────╯
                // clang-format on
                >;
        };

        mouse_layer {
            label = "MOUSE";
            bindings = <
                // clang-format off
//╭─────────────┬─────────────┬─────────────┬─────────────┬─────────────┬─────────────╮  ╭─────────────┬─────────────┬─────────────┬─────────────┬─────────────┬─────────────╮
    XXX           XXX           XXX           XXX           XXX           XXX              XXX           U_WH_D        U_MS_U        U_WH_U        XXX           XXX
//├─────────────┼─────────────┼─────────────┼─────────────┼─────────────┼─────────────┤  ├─────────────┼─────────────┼─────────────┼─────────────┼─────────────┼─────────────┤
    XXX           XXX           XXX           XXX           XXX           XXX              XXX           U_MS_L        U_MS_D        U_MS_R        XXX           XXX
//├─────────────┼─────────────┼─────────────┼─────────────┼─────────────┼─────────────┤  ├─────────────┼─────────────┼─────────────┼─────────────┼─────────────┼─────────────┤
    XXX           XXX           XXX           XXX           XXX           XXX              XXX           XXX           XXX           XXX           XXX           XXX
//╰─────────────┴─────────────┴─────────────┴─────────────┼─────────────┼─────────────┤  ├─────────────┼─────────────┼─────────────┼─────────────┴─────────────┴─────────────╯
                                              XXX           XXX           XXX              U_BTN2        U_BTN1        XXX
//                                          ╰─────────────┴─────────────┴─────────────╯  ╰─────────────┴─────────────┴─────────────╯
                // clang-format on
                >;
        };

        adjust_layer {
            label = "ADJUST";
            bindings = <
                // clang-format off
//╭─────────────┬──────────────┬─────────────┬─────────────┬─────────────┬─────────────╮  ╭─────────────┬─────────────┬─────────────┬─────────────┬─────────────┬─────────────╮
    XXX           XXX            XXX           XXX           XXX           XXX              XXX           XXX           XXX           XXX           XXX           XXX
//├─────────────┼──────────────┼─────────────┼─────────────┼─────────────┼─────────────┤  ├─────────────┼─────────────┼─────────────┼─────────────┼─────────────┼─────────────┤
    &bt BT_CLR    &bt BT_SEL 0   &bt BT_SEL 1  &bt BT_SEL 2  &bt BT_SEL 3  &bt BT_SEL 4     &to GAME      XXX           XXX           XXX           XXX           XXX
//├─────────────┼──────────────┼─────────────┼─────────────┼─────────────┼─────────────┤  ├─────────────┼─────────────┼─────────────┼─────────────┼─────────────┼─────────────┤
    XXX           XXX            XXX           XXX           XXX           XXX              XXX           XXX           XXX           XXX           XXX           XXX
//╰─────────────┴──────────────┴─────────────┴─────────────┼─────────────┼─────────────┤  ├─────────────┼─────────────┼─────────────┼─────────────┴─────────────┴─────────────╯
                                               XXX           XXX           XXX              XXX           XXX           XXX
//                                           ╰─────────────┴─────────────┴─────────────╯  ╰─────────────┴─────────────┴─────────────╯
                // clang-format on
                >;
        };
    };
};
